#include <behaviors.dtsi>
#include <dt-bindings/zmk/keys.h>

/ {
    keymap {
        compatible = "zmk,keymap";

        default_layer {
            // 버튼 3개 (D2, D3, D4)
            bindings = <
                &kp A  &kp B  &kp C
            >;
            
            // 로터리 엔코더 (시계방향: 볼륨업, 반시계방향: 볼륨다운)
            sensor-bindings = <&inc_dec_kp C_VOL_UP C_VOL_DN>;
        };
    };
};
