/ {
    // 로터리 엔코더 핀 설정 (D0, D1)
    encoder: encoder {
        compatible = "alps,ec11";
        label = "ENCODER";
        a-gpios = <&xiao_d 0 (GPIO_ACTIVE_LOW | GPIO_PULL_UP)>;
        b-gpios = <&xiao_d 1 (GPIO_ACTIVE_LOW | GPIO_PULL_UP)>;
        resolution = <4>;
    };

    // 스위치 핀 설정 (D2, D3, D4)
    sensors {
        compatible = "zmk,keymap-sensors";
        sensors = <&encoder>;
    };
};
