#include <behaviors.dtsi>
#include <dt-bindings/zmk/keys.h>

/ {
    keymap {
        compatible = "zmk,keymap";
        default_layer {
            bindings = <
                &kp A &kp B &kp C
            >;
            sensor-bindings = <&inc_dec_kp VOL_UP VOL_DN>;
        };
    };
};
