#include <behaviors.dtsi>
#include <dt-bindings/zmk/keys.h>
#include <dt-bindings/zmk/bt.h>

/ {
    sensors {
        compatible = "zmk,keymap-sensors";
        sensors = <&encoder>;
    };

    keymap {
        compatible = "zmk,keymap";
        default_layer {
            // 버튼들: D2(엔코더클릭), D3(스위치1), D4(스위치2) 순서
            bindings = <
                &kp C_PP      // 엔코더 클릭 -> 재생/일시정지
                &kp C_MUTE    // 스위치 1 -> 음소거
                &kp C_NEXT    // 스위치 2 -> 다음곡
            >;

            // 로터리 엔코더: D0, D1 연결
            sensor-bindings = <&inc_dec_kp C_VOL_UP C_VOL_DN>;
        };
    };
};
